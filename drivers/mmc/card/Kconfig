## drivers/mmc/card/Kconfig
```kconfig
#
# MMC/SD card drivers
#

comment "MMC/SD/SDIO Card Drivers"

config MMC_BLOCK
	tristate "MMC block device driver"
	depends on BLOCK
	default y
	help
	  Say Y here to enable the MMC block device driver support.
	  This provides a block device driver, which you can use to
	  mount the filesystem. Almost everyone wishing MMC support
	  should say Y or M here.

config MMC_BLOCK_MINORS
	int "Number of minors per block device"
	depends on MMC_BLOCK
	range 4 256
	default 8
	help
	  Number of minors per block device. One is needed for every
	  partition on the disk (plus one for the whole disk).

	  Number of total MMC minors available is 256, so your number
	  of supported block devices will be limited to 256 divided
	  by this number.

	  Default is 8 to be backwards compatible with previous
	  hardwired device numbering.

	  If unsure, say 8 here.

config MMC_BLOCK_QUIRKS
       tristate "MMC block device quirks"
       depends on MMC_BLOCK
       default y
       help
         Say Y here to enable various workarounds for known cards.

config MMC_BLOCK_QUIRK_TOSHIBA_32NM
       tristate "Toshiba MMC 32nm technology flash device quirks"
       depends on MMC_BLOCK_QUIRKS
       default n
       help
         Say Y if you have a Toshiba 32nm technology flash device,
	 such as MMC32G or MMC16G eMMCs.

config MMC_BLOCK_QUIRK_TOSHIBA_32NM_REL
       tristate "Toshiba MMC 32nm reliability quirk"
       depends on MMC_BLOCK_QUIRK_TOSHIBA_32NM
       default n
       help
         Say Y if you want to enable the improved reliability workaround
	 for your Toshiba 32nm parts. This will result in certain-sized
	 writes to be split up into 8K chunks, to ensure they are placed
	 in the smaller 8KB buffer instead of the 4MB buffer, which should
	 reduce the number of flash write-erase cycles and improve
	 reliability. By default accesses in the 24k-32k range are
	 split.

config MMC_BLOCK_QUIRK_TOSHIBA_32NM_REL_L
       hex "Toshiba reliability lower bound (in blocks)"
       depends on MMC_BLOCK_QUIRK_TOSHIBA_32NM_REL
       default "30"
       help
         Accesses smaller than the lower bound will not be split.
	 This value should be experimentally found to match load
	 and performance characteristics.

config MMC_BLOCK_QUIRK_TOSHIBA_32NM_REL_U
       hex "Toshiba reliability upper bound (in blocks)"
       depends on MMC_BLOCK_QUIRK_TOSHIBA_32NM_REL
       default "40"
       help
         Accesses bigger than the upper bound will not be split.
	 This value should be experimentally found to match load
	 and performance characteristics.

config MMC_BLOCK_BOUNCE
	bool "Use bounce buffer for simple hosts"
	depends on MMC_BLOCK
	default y
	help
	  SD/MMC is a high latency protocol where it is crucial to
	  send large requests in order to get high performance. Many
	  controllers, however, are restricted to continuous memory
	  (i.e. they can't do scatter-gather), something the kernel
	  rarely can provide.

	  Say Y here to help these restricted hosts by bouncing
	  requests back and forth from a large buffer. You will get
	  a big performance gain at the cost of up to 64 KiB of
	  physical memory.

	  If unsure, say Y here.

config MMC_BLOCK_DEFERRED_RESUME
	bool "Deferr MMC layer resume until I/O is requested"
	depends on MMC_BLOCK
	default n
	help
	  Say Y here to enable deferred MMC resume until I/O
	  is requested. This will reduce overall resume latency and
	  save power when theres an SD card inserted but not being used.

config SDIO_UART
	tristate "SDIO UART/GPS class support"
	help
	  SDIO function driver for SDIO cards that implements the UART
	  class, as well as the GPS class which appears like a UART.

config MMC_TEST
	tristate "MMC host test driver"
	help
	  Development driver that performs a series of reads and writes
	  to a memory card in order to expose certain well known bugs
	  in host controllers. The tests are executed by writing to the
	  "test" file in debugfs under each card. Note that whatever is
	  on your card will be overwritten by these tests.

	  This driver is only of interest to those developing or
	  testing a host driver. Most people should say N here.
```
